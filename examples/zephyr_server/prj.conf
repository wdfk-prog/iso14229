## CMakeLists.txt
```
cmake_minimum_required(VERSION 3.28.0)

find_package(Zephyr)
project(uds_server)

set(ISO14229_DIR ${CMAKE_CURRENT_SOURCE_DIR}/../..)

target_sources(app PRIVATE
    src/main.c
    ${ISO14229_DIR}/iso14229.c
)
target_include_directories(app PRIVATE ${ISO14229_DIR})
target_compile_definitions(app PRIVATE
    UDS_SERVER_SEND_BUF_SIZE=256
    UDS_SERVER_RECV_BUF_SIZE=256
)
```

## prj.conf
```kconfig
CONFIG_CAN=y
CONFIG_ISOTP=y
CONFIG_REBOOT=y
# CONFIG_LOG=y
# CONFIG_CAN_LOG_LEVEL_DBG=y
# CONFIG_ISOTP_LOG_LEVEL_DBG=y
# CONFIG_CAN_STATS=y
# CONFIG_CAN_SHELL=y
```

## boards/nucleo_g474re.overlay
```dts
// the board's default devicetree already claims PB8/PB9 for i2c1; disable it so FDCAN1 owns the pins
&i2c1 {
	status = "disabled";
};

&fdcan1 {
	pinctrl-0 = <&fdcan1_rx_pb8 &fdcan1_tx_pb9>;
	bitrate = <500000>;
	sample-point = <792>;
};
```

## src/main.c
```c
#include <zephyr/kernel.h>
#include <zephyr/device.h>
#include <zephyr/sys/reboot.h>

#include "iso14229.h"

#define PHYS_RX_ADDR 0x7E0
#define PHYS_TX_ADDR 0x7E8
#define FUNC_RX_ADDR 0x7DF

static UDSErr_t fn(UDSServer_t *srv, UDSEvent_t ev, void *arg) {
    (void)srv;
    (void)arg;
    switch (ev) {
    case UDS_EVT_DiagSessCtrl:
    case UDS_EVT_EcuReset:
        return UDS_PositiveResponse;
    case UDS_EVT_DoScheduledReset:
        sys_reboot(SYS_REBOOT_WARM);
        return UDS_OK;
    default:
        return UDS_NRC_ServiceNotSupported;
    }
}

int main(void) {
    static UDSServer_t srv;
    static UDSTpISOTpZephyr_t tp;

    const struct device *can_dev = DEVICE_DT_GET(DT_CHOSEN(zephyr_canbus));
    if (UDSServerTpISOTpZephyrInit(&tp, can_dev, PHYS_RX_ADDR, PHYS_TX_ADDR, FUNC_RX_ADDR)) {
        return -1;
    }

    UDSServerInit(&srv);
    srv.tp = &tp.hdl;
    srv.fn = fn;

    while (1) {
        UDSServerPoll(&srv);
        k_msleep(1);
    }
    return 0;
}
```
